## Kconfig
```kconfig
mainmenu "SLVC DMA public flow"

menu "Implementation profile"

config SLVC_DMA_PROFILE_ID
  string "Selected public profile identifier"
  default "slvc_dma_512"

config SLVC_DMA_V1_512
  bool "Enable the 512-bit SLVC DMA release profile"
  default y

config SLVC_DMA_TOP
  string "OOC timing top"
  default "frame_dma_wrapper"

config SLVC_DMA_CLOCK_PERIOD_NS
  string "OOC clock period in ns"
  default "5.000"

config SLVC_DMA_MEM_CLOCK_PERIOD_NS
  string "RX memory OOC clock period in ns"
  default "5.000"

config SLVC_DMA_RX_WIDE_PAYLOAD
  bool "Enable optional same-clock 512-bit RX payload AXI master profile"
  default n
  depends on SLVC_DMA_V1_512

config SLVC_DMA_RX_MEM_ASYNC64
  bool "Enable optional dual-clock 64-bit RX memory backend"
  default n
  depends on SLVC_DMA_V1_512 && !SLVC_DMA_RX_WIDE_PAYLOAD && !SLVC_DMA_RX_MEM_ASYNC512

config SLVC_DMA_RX_MEM_ASYNC512
  bool "Enable optional dual-clock 512-bit RX memory backend"
  default n
  depends on SLVC_DMA_V1_512 && !SLVC_DMA_RX_WIDE_PAYLOAD && !SLVC_DMA_RX_MEM_ASYNC64

config SLVC_DMA_UDP_IPV4_ADAPTER
  bool "Enable optional 512-bit UDP/IPv4 to SHDR64 adapter tests"
  default y

endmenu

menu "Enabled stages"

config SLVC_DMA_SIM
  bool "Run selected ModelSim regression"
  default y

config SLVC_DMA_FPGA_OOC
  bool "Run Vivado 2018.3 OOC implementation"
  default y

config SLVC_DMA_ADAPTER_DC_OOC
  bool "Run adapter-only Design Compiler OOC synthesis"
  default y

config SLVC_DMA_RX_WRITER_DC_OOC
  bool "Run RX payload writer Design Compiler OOC synthesis"
  default n

config SLVC_DMA_VIVADO_ASYNC64_2022_2_OOC
  bool "Run Vivado 2022.2 async64 OOC implementation"
  default n
  depends on SLVC_DMA_RX_MEM_ASYNC64

config SLVC_DMA_N45_C2_REG_AUDIT
  bool "Audit the Nangate45 C2B4 register profile"
  default n

config SLVC_DMA_N45_C2_REG_SIM
  bool "Run the C2B4 focused regression"
  default n

config SLVC_DMA_N45_C2_REG_DC
  bool "Run C2B4 Design Compiler synthesis"
  default n

config SLVC_DMA_N45_C2_REG_PNR
  bool "Run C2B4 OpenROAD/OpenRCX physical implementation"
  default n

config SLVC_DMA_N45_C2_REG_STA
  bool "Run C2B4 PrimeTime post-route STA"
  default n

endmenu
```

## configs/dma_rx512_reg_c2_b4_m2_sp64_defconfig
```kconfig
CONFIG_SLVC_DMA_PROFILE_ID="dma_rx512_reg_c2_b4_m2_sp64"
CONFIG_SLVC_DMA_V1_512=y
CONFIG_SLVC_DMA_TOP="dma_rx512_memory_subsystem_top"
CONFIG_SLVC_DMA_CLOCK_PERIOD_NS="5.000"
CONFIG_SLVC_DMA_MEM_CLOCK_PERIOD_NS="5.000"
CONFIG_SLVC_DMA_RX_WIDE_PAYLOAD=n
CONFIG_SLVC_DMA_RX_MEM_ASYNC64=n
CONFIG_SLVC_DMA_RX_MEM_ASYNC512=n
CONFIG_SLVC_DMA_UDP_IPV4_ADAPTER=n
CONFIG_SLVC_DMA_SIM=n
CONFIG_SLVC_DMA_FPGA_OOC=n
CONFIG_SLVC_DMA_ADAPTER_DC_OOC=n
CONFIG_SLVC_DMA_RX_WRITER_DC_OOC=n
CONFIG_SLVC_DMA_VIVADO_ASYNC64_2022_2_OOC=n
CONFIG_SLVC_DMA_N45_C2_REG_AUDIT=y
CONFIG_SLVC_DMA_N45_C2_REG_SIM=y
CONFIG_SLVC_DMA_N45_C2_REG_DC=y
CONFIG_SLVC_DMA_N45_C2_REG_PNR=y
CONFIG_SLVC_DMA_N45_C2_REG_STA=y
```

## configs/slvc_dma_512_rx_async64_defconfig
```kconfig
CONFIG_SLVC_DMA_PROFILE_ID="slvc_dma_512_rx_async64"
CONFIG_SLVC_DMA_V1_512=y
CONFIG_SLVC_DMA_TOP="frame_dma_rx_top"
CONFIG_SLVC_DMA_CLOCK_PERIOD_NS="5.000"
CONFIG_SLVC_DMA_MEM_CLOCK_PERIOD_NS="5.000"
CONFIG_SLVC_DMA_RX_WIDE_PAYLOAD=n
CONFIG_SLVC_DMA_RX_MEM_ASYNC64=y
CONFIG_SLVC_DMA_RX_MEM_ASYNC512=n
CONFIG_SLVC_DMA_UDP_IPV4_ADAPTER=n
CONFIG_SLVC_DMA_SIM=y
CONFIG_SLVC_DMA_FPGA_OOC=y
CONFIG_SLVC_DMA_ADAPTER_DC_OOC=n
CONFIG_SLVC_DMA_RX_WRITER_DC_OOC=y
CONFIG_SLVC_DMA_VIVADO_ASYNC64_2022_2_OOC=y
CONFIG_SLVC_DMA_N45_C2_REG_AUDIT=n
CONFIG_SLVC_DMA_N45_C2_REG_SIM=n
CONFIG_SLVC_DMA_N45_C2_REG_DC=n
CONFIG_SLVC_DMA_N45_C2_REG_PNR=n
CONFIG_SLVC_DMA_N45_C2_REG_STA=n
```
