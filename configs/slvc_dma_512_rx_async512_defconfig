## configs/slvc_dma_512_rx_async512_defconfig
```kconfig
CONFIG_SLVC_DMA_V1_512=y
CONFIG_SLVC_DMA_TOP="frame_dma_rx_top"
CONFIG_SLVC_DMA_CLOCK_PERIOD_NS="5.000"
CONFIG_SLVC_DMA_MEM_CLOCK_PERIOD_NS="5.000"
CONFIG_SLVC_DMA_SIM=y
CONFIG_SLVC_DMA_FPGA_OOC=y
CONFIG_SLVC_DMA_RX_MEM_ASYNC512=y
CONFIG_SLVC_DMA_UDP_IPV4_ADAPTER=n
CONFIG_SLVC_DMA_ADAPTER_DC_OOC=n
```
